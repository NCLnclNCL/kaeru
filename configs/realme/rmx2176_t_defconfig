## configs/realme/rmx2176_t_defconfig
```kconfig
CONFIG_APP_CALLER=0x4C42AFA4
CONFIG_APP_ADDRESS=0x4c42e3f8
CONFIG_DPRINTF_ADDRESS=0x4c443f74
CONFIG_THREAD_SUPPORT=y
CONFIG_STAGE1_SUPPORT=y
CONFIG_LEGACY_LK=n
CONFIG_BOOTMODE_ADDRESS=0x4c5375b0
CONFIG_BOOTLOADER_BASE=0x4C400000
CONFIG_BOOTLOADER_SIZE=0x134130
CONFIG_FASTBOOT_FAIL_ADDRESS=0x4C42EFB0
CONFIG_FASTBOOT_INFO_ADDRESS=0x4C42EF30
CONFIG_FASTBOOT_OKAY_ADDRESS=0x4C42F17C
CONFIG_FASTBOOT_PUBLISH_ADDRESS=0x4C42EADC
CONFIG_FASTBOOT_REGISTER_ADDRESS=0x4C42EAA0
CONFIG_FREE_ADDRESS=0x4C4443A8
CONFIG_LK_LOG_STORE_ADDRESS=0x4C457234
CONFIG_MALLOC_ADDRESS=0x4C41F04C
CONFIG_THREAD_CREATE_ADDRESS=0x4C42A0D4
CONFIG_VIDEO_PRINTF_ADDRESS=0x4C443900
CONFIG_THREAD_RESUME_ADDRESS=0x4c42a2ec
CONFIG_REALME_RMX2176_T=y
CONFIG_MEDIATEK_MT6853=y
CONFIG_MTK_DETECT_KEY_ADDRESS=0x4c405ba0
CONFIG_PLATFORM_INIT_CALLER=0x4c429912
CONFIG_PLATFORM_INIT_ADDRESS=0x4c403c28
CONFIG_INIT_STORAGE_CALLER=0x4c403c5c
CONFIG_INIT_STORAGE_ADDRESS=0x4c403a84
CONFIG_SPOOF_SUPPORT=n
CONFIG_PARTITION_GET_SIZE_BY_NAME_ADDRESS=0x4c45dfe0
CONFIG_PARTITION_READ_ADDRESS=0x4c45f8f0
CONFIG_SET_ENV_ADDRESS=0x4c45e9c0
CONFIG_GET_ENV_ADDRESS=0x4c45e7a8
CONFIG_ENVIRONMENT_SUPPORT=y
```
