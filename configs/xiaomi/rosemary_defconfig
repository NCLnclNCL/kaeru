## configs/xiaomi/rosemary_defconfig
```kconfig
CONFIG_APP_CALLER=0x4C4224F4
CONFIG_APP_ADDRESS=0x4C425EA4
CONFIG_BOOTLOADER_BASE=0x4C400000
CONFIG_BOOTLOADER_SIZE=0x189680
CONFIG_BOOTMODE_ADDRESS=0x4C58C61C
CONFIG_FASTBOOT_INFO_ADDRESS=0x4C426A9C
CONFIG_FASTBOOT_FAIL_ADDRESS=0x4C426C3C
CONFIG_FASTBOOT_OKAY_ADDRESS=0x4C426EF8
CONFIG_FASTBOOT_PUBLISH_ADDRESS=0x4C426648
CONFIG_FASTBOOT_REGISTER_ADDRESS=0x4C42660C
CONFIG_LK_LOG_STORE_ADDRESS=0x4C44E104
CONFIG_MTK_DETECT_KEY_ADDRESS=0x4C405440
CONFIG_PLATFORM_INIT_ADDRESS=0x4C4038C0
CONFIG_PLATFORM_INIT_CALLER=0x4C420E50
CONFIG_VIDEO_PRINTF_ADDRESS=0x4C42827C
CONFIG_THREAD_CREATE_ADDRESS=0x4C42160C
CONFIG_THREAD_RESUME_ADDRESS=0x4C421820
CONFIG_DPRINTF_ADDRESS=0x4C43A990
CONFIG_MALLO_ADDRESSC=0x4C43B698
CONFIG_FREE_ADDRESS=0x4C43ADC0
CONFIG_PARTITION_READ_ADDRESS=0x4C456DBC
CONFIG_XIAOMI_ROSEMARY=y
CONFIG_MEDIATEK_MT6785=y
CONFIG_BOOTMODE_ADDRESS=0x4c428a2e
CONFIG_THREAD_SUPPORT=y
CONFIG_STAGE1_SUPPORT=y
CONFIG_LEGACY_LK=n
CONFIG_SPOOF_SUPPORT=y
CONFIG_PARTITION_GET_SIZE_BY_NAME_ADDRESS=0x4c45559c
CONFIG_PARTITION_READ_ADDRESS=0x4c456dbc
CONFIG_SET_ENV_ADDRESS=0x4c45607c
CONFIG_GET_ENV_ADDRESS=0x4c455e64
CONFIG_PLATFORM_INIT_ADDRESS=0x4c4038c0
```
